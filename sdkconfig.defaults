## sdkconfig.defaults
```kconfig
# Override some defaults so BT stack is enabled
# in this example

CONFIG_PARTITION_TABLE_CUSTOM=y

CONFIG_ESPTOOLPY_PORT="COM3"
CONFIG_ESPTOOLPY_BAUD_921600B=y
CONFIG_ESPTOOLPY_BAUD=921600
CONFIG_ESPTOOLPY_COMPRESSED=y
CONFIG_MONITOR_BAUD=921600
#
# BT config
#
CONFIG_BT_ENABLED=y
#CLASSIC_BT_ENABLED=n
#BT_DRAM_RELEASE=y
#BT_RESERVE_DRAM=0x10000
#CONFIG_SMP_ENABLE=n

#
# ESP32-specific config
#
CONFIG_ESP32_ENABLE_STACK_BT=y
# CONFIG_ESP32_ENABLE_STACK_NONE is not set
CONFIG_MEMMAP_BT=y
```
